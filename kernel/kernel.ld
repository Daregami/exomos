ENTRY (kernel_main) /* Точка входа в ядро */
SECTIONS
{
    . = 0xC0100000; /* Базовый адрес по которому было загружено ядро */

    .text : AT(0x100000) { *(.text) } /* Сюда собирается весь код */

    . = ALIGN(4096);
    .rodata : { *(.rodata) } /* Сюда идут все константные строки */

    . = ALIGN(4096);
    .data : { *(.data) } /* Сюда идут все инициализированные переменные */
    
    . = ALIGN(4096);
    .bss : { *(.bss) *(COMMON) } /* Сюда идут все нулевые переменные */

    . = ALIGN(4096);
    _kernel_end = .; /* Виртуальный адрес конца ядра */
}